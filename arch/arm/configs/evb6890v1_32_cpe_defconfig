## drivers/gpu/drm/mediatek/Kconfig
```kconfig
config DRM_MEDIATEK
	tristate "DRM Support for Mediatek SoCs"
	depends on DRM
	depends on ARCH_MEDIATEK || (ARM && COMPILE_TEST)
	depends on COMMON_CLK
	depends on HAVE_ARM_SMCCC
	depends on OF
	select DRM_GEM_CMA_HELPER
	select DRM_KMS_HELPER
	select DRM_MIPI_DSI
	select DRM_PANEL
	select MEMORY
	select MTK_SMI
	select MTK_DISPLAY_CMDQ
	select VIDEOMODE_HELPERS
	help
	  Choose this option if you have a Mediatek SoCs.
	  The module will be called mediatek-drm
	  This driver provides kernel mode setting and
	  buffer management to userspace.

config MTK_DISPLAY_CMDQ
        bool "CMDQ Support for Mediatek DRM driver"
        help
          Choose this option if you have a Mediatek SoCs.
          The module will be called mediatek-drm
          This driver provides kernel mode setting and
          buffer management to userspace.

config MTK_DISPLAY_COLOR
        bool "COLOR Support for Mediatek DRM driver"
        help
          Choose this option if you have a Mediatek SoCs.
          The module will be called mediatek-drm
          This driver provides picture quality setting
          Such as: brightness, contrast, saturation and so on.

config MTK_DISPLAY_FULL_TUNING_COLOR
        bool "FULL COLOR Support for Mediatek DRM driver"
        help
          Choose this option if you have a Mediatek SoCs.
          The module will be called mediatek-drm
          This driver provides full picture quality tuning
          Such as: global brightness, contrast, saturation and single region hue.

config MTK_DISPLAY_RVC
	bool "RVC Support for Mediatek DRM driver"
	help
	  Choose this option if you want to activate fast RVC.
	  RVC is rear camera for automotive application.
	  This driver provides kernel mode setting and
	  buffer management to userspace.

config MTK_LCM_PHYSICAL_ROTATION_HW
    bool "Rotate LCM display for 180 degree using HW"
    help
      Rotate LCM display for 180 degree using mediatek hardware engine
      Enable it when LCM hardware is intalled upside down, and you need
      to rotate the display content to adapting.
      Select "y" if you want to enable LCM 180 rotate.
      Select "n" if unsure.

config DRM_MEDIATEK_HDMI
	tristate "DRM HDMI Support for Mediatek SoCs"
	depends on DRM_MEDIATEK
	select SND_SOC_HDMI_CODEC if SND_SOC
	select GENERIC_PHY
	help
	  DRM/KMS HDMI driver for Mediatek SoCs

config MTK_DISPLAY_PQSERVICE
	bool "Open root_only permission for drop drm master ioctl"
	help
	  Choose this option if build pqservice binary.
	  Please configure pqservice to drop drm master
	  to HWC.

config DRM_DSI_SUPPORT
	bool "Drm interface"
	depends on OF
	depends on BACKLIGHT_CLASS_DEVICE
	help
		Config y if device need to use DSI panel. Default value is n for DBI panel.
```

## drivers/misc/mediatek/hsapif/Kconfig
```kconfig
config MTK_HSAPIF_DRIVER
	bool "Enable Evolved CLDMA Driver as interface for PCIE"
	default y
	help
	  This option enables CLDMA device driver support,
	  if yes, then PC is using cldma driver,
	  if no, cldma driver is disabled.
	  The option default enable.
```

## drivers/misc/mediatek/leds/Kconfig
```kconfig
config MTK_LEDS
	tristate "MediaTek LED Support"
	depends on LEDS_CLASS
	help
	  This selects the MediaTek(R) LEDs connected to MediaTek chips.
	  If you want to use MediaTek(R) LEDs support, say Y or M here.
	  If unsure, say N.
	  Mediatek LED module includes backlight, indicate LED, keypad LED, button LED etc.

config LEDS_MT6330
	tristate "LED Support for Mediatek MT6330 PMIC"
	depends on LEDS_CLASS
	help
	  This option enables support for on-chip LED drivers found on
	  Mediatek MT6330 PMIC.
	  If you want to use MediaTek(R) LEDs support, say Y or M here.
	  If unsure, say N.
```

## drivers/misc/mediatek/lpm/Kconfig
```kconfig
config MTK_LOW_POWER_MODULE
	bool "Meditaek Low Power Module"
	help
	   Select MTK_LOW_POWER_MODULE then Mediatek low module
	   feature will be enabled. The common debug

config MTK_LPM_DBG_COMMON
	tristate "Meditaek Low Power common debug Module"
	help
	   Select MTK_LPM_DBG_COMMON then Mediatek low module
	   common debug feature will be enabled. The common debug
	   feature will support basic debug control and show the
	   information to console.

config MTK_LPM_MT6779
	tristate "Specify Mediatek LPM Platform is MT6779"
	depends on MTK_LOW_POWER_MODULE
	select MTK_LPM_DBG_COMMON
	help
	  Select MediaTek Low Power Module Platform is MT6779
	  for power management.
	  Set Y to select this feature for specific platform-mt6779.
	  If unsure, set N to disable.

config MTK_LPM_MT6880
	tristate "Specify Mediatek LPM Platform is MT6880"
	depends on MTK_LOW_POWER_MODULE
	select MTK_LPM_DBG_COMMON
	help
	  Select MediaTek Low Power Module Platform is MT6880
	  for power management.
	  Set Y to select this feature for specific platform-mt6779.
	  If unsure, set N to disable.
```

## drivers/misc/mediatek/pcie/Kconfig
```kconfig
config MTK_PCIE
	bool "Mediatek PCIe misc setting"
	help
	  Set Y to add support for the misc settings of MediaTek PCIe.
	  If unsure, Set N.

config MTK_PCIE_EP
	bool "Mediatek PCIe EP mode"
	depends on MTK_PCIE
	help
	  Set Y to support PCIe EP mode.
	  If unsure, Set N.

config MTK_PCIE_DIPC
	bool "Mediatek PCIe Dual IPC"
	depends on MTK_PCIE_EP
	select MTK_MHCCIF
	help
	  Set Y to add PCIe dual IPC support,
	  If unsure, Set N.

config MTK_PCIE_SMT_SUPPORT
	bool "Mediatek PCIe SMT test"
	depends on MTK_PCIE
	help
	  PCIe loopback test for SMT.
	  Set Y to enable this feature.
	  If unsure, Set N.
```

## drivers/misc/mediatek/secure_dp/Kconfig
```kconfig
config MTK_SECURE_DATA_PROTECTION
	bool "Mediatek secure data protection support"
	help
		Mediatek Secure Data Protection module can protect data such as password.
		If configures to be y, It can use encrypt/decrypt API to protect data by hw
		in kernel.
		If configures to be n, Other modules cannot use the exported APIs.

config MTK_SECURE_STATUS_QUERY
	bool "Mediatek secure status query support"
	help
		Mediatek Secure Status Query API acquire the status of secure device.
		If configures to be y, You can use query API to acquire status.
		If configures to be n, Other modules cannot use the exported APIs.
```

## drivers/misc/mediatek/sensor/2.0/Kconfig
```kconfig
source "drivers/misc/mediatek/sensor/2.0/bmp380/Kconfig"
source "drivers/misc/mediatek/sensor/2.0/test/Kconfig"
```

## drivers/misc/mediatek/systracker/Kconfig
```kconfig
config MTK_SYSTRACKER_V2
	bool "Enable MTK System Tracker Debugger V2"
	help
	  SYSTRACKER driver is a debugging feature.
	  SYSTRACKER is a hardware debugger to record timeout transaction
	  and trigger SLV_ERR or interrupt to notify CPU.
	  Support 2 stage timeout & watchpoint SLV_ERR

config MTK_SYSTRACKER_MT6890
	bool "Systracker driver for MediaTek MT6880"
	help
	  SYSTRACKER driver is a debugging feature.
	  If you wish to use this debug resource from the MT6880 SOC,
	  say Y. Otherwise, pls say N.

config MTK_SYSTRACKER_MT6880
	bool "Systracker driver for MediaTek MT6890"
	help
	  SYSTRACKER driver is a debugging feature.
	  If you wish to use this debug resource from the MT6890 SOC,
	  say Y. Otherwise, pls say N.
```

## drivers/mtd/parsers/Kconfig
```kconfig
config MTD_PARSER_TRX
	tristate "Parser for TRX format partitions"
	depends on MTD && (BCM47XX || ARCH_BCM_5301X || COMPILE_TEST)
	help
	  TRX is a firmware format used by Broadcom on their devices. It
	  may contain up to 3/4 partitions (depending on the version).
	  This driver will parse TRX header and report at least two partitions:
	  kernel and rootfs.

config MTD_SHARPSL_PARTS
	tristate "Sharp SL Series NAND flash partition parser"
	depends on MTD_NAND_SHARPSL || MTD_NAND_TMIO || COMPILE_TEST
	help
	  This provides the read-only FTL logic necessary to read the partition
	  table from the NAND flash of Sharp SL Series (Zaurus) and the MTD
	  partition parser using this code.

config MTD_ROUTERBOOT_PARTS
	tristate "RouterBoot flash partition parser"
	depends on MTD && OF
	help
	  MikroTik RouterBoot is implemented as a multi segment system on the
	  flash, some of which are fixed and some of which are located at
	  variable offsets. This parser handles both cases via properly
	  formatted DTS.
```

## drivers/soc/mediatek/devapc/Kconfig
```kconfig
config MTK_DEVAPC
	tristate "Mediatek Device APC Support"
	help
	  Device APC is a kernel driver controlling internal device security.
	  If someone tries to access a device, which is not allowed by the
	  device, it cannot access the device and will get a violation
	  interrupt. Device APC prevents malicious access to internal devices.

config DEVAPC_ARCH_V1
	tristate "Mediatek Device APC driver architecture v1"
	help
	  Say yes here to enable support Mediatek
	  Device APC driver which is based on HW
	  architecture version 1.
	  This architecture supports 1 Infra-peri.

config DEVAPC_ARCH_V2
	bool "Mediatek Device APC driver architecture v2"
	help
	  Say yes here to enable support Mediatek
	  Device APC driver which is based on HW
	  architecture version 2.
	  This architecture supports multiple Infra AO.

config DEVAPC_MMAP_DEBUG
	bool "Mediatek Device APC memory map debug mode"
	help
	  Say yes here to enable support Mediatek
	  Device APC driver to debug violation
	  through catching illegal memory mapped
	  range.

config DEVAPC_MT6779
	tristate "Mediatek MT6779 Device APC driver"
	depends on ARCH_MEDIATEK || COMPILE_TEST
	select DEVAPC_ARCH_V1
	select MTK_DEVAPC
	help
	  Say yes here to enable support Mediatek MT6779
	  Device APC driver.
	  This driver is combined with DEVAPC_ARCH_V1 for
	  common handle flow.

config DEVAPC_MT6880
	bool "Mediatek MT6880 Device APC driver"
	depends on ARCH_MEDIATEK || COMPILE_TEST
	select DEVAPC_ARCH_V2
	select MTK_DEVAPC
	select DEVAPC_MMAP_DEBUG
	help
	  Say yes here to enable support Mediatek MT6880
	  Device APC driver.
	  This driver is combined with DEVAPC_ARCH_V2 for
	  common handle flow.
```
